## boards/shields/aerogu38/Kconfig.shield
```kconfig
config SHIELD_AEROGU38_LEFT
    def_bool $(shields_list_contains,aerogu38_left)

config SHIELD_AEROGU38_RIGHT
    def_bool $(shields_list_contains,aerogu38_right)
```
